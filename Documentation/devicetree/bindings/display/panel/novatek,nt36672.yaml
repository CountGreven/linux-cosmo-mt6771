## Documentation/devicetree/bindings/media/mediatek,mt8183-camsv.yaml
```yaml
# SPDX-License-Identifier: (GPL-2.0-only OR BSD-2-Clause)
%YAML 1.2
---
$id: http://devicetree.org/schemas/media/mediatek,mt8183-camsv.yaml#
$schema: http://devicetree.org/meta-schemas/core.yaml#

title: MediaTek CAMSV raw capture unit

maintainers:
  - Fredrik Lindlöf <fredrik.lindlof@gmail.com>

description:
  A CAMSV unit of the MediaTek MT8183 family (also MT6771) takes the stream
  of one SENINF mux and writes the raw Bayer frames to memory. The camera
  system has several units; the ones with a clock gate and an interrupt are
  described by this binding.

properties:
  compatible:
    oneOf:
      - const: mediatek,mt8183-camsv
      - items:
          - const: mediatek,mt6771-camsv
          - const: mediatek,mt8183-camsv

  reg:
    maxItems: 1

  interrupts:
    maxItems: 1

  clocks:
    items:
      - description: CAMSV gate in the camera system
      - description: camera core gate in the camera system
      - description: timing generator gate in the camera system

  clock-names:
    items:
      - const: camsv
      - const: cam
      - const: camtg

  power-domains:
    maxItems: 1

  iommus:
    maxItems: 1
    description: Memory port of the DMA once it is known.

  mediatek,larb:
    $ref: /schemas/types.yaml#/definitions/phandle-array
    items:
      maxItems: 1
    description:
      SMI larbs to keep powered while the DMA runs, for a unit that has no
      iommus property and writes physical addresses. Dropped once the
      memory port is known.

  memory-region:
    maxItems: 1
    description:
      Contiguous memory below 4 GiB for the frame buffers of a unit that has
      no iommus property.

  ports:
    $ref: /schemas/graph.yaml#/properties/ports

    properties:
      port@0:
        $ref: /schemas/graph.yaml#/properties/port
        description: Input from a SENINF mux.

    required:
      - port@0

required:
  - compatible
  - reg
  - interrupts
  - clocks
  - clock-names
  - power-domains
  - ports

additionalProperties: false

examples:
  - |
    #include <dt-bindings/clock/mt8183-clk.h>
    #include <dt-bindings/interrupt-controller/arm-gic.h>
    #include <dt-bindings/power/mt8183-power.h>

    soc {
        #address-cells = <2>;
        #size-cells = <2>;

        camsv@1a050000 {
            compatible = "mediatek,mt6771-camsv", "mediatek,mt8183-camsv";
            reg = <0 0x1a050000 0 0x1000>;
            interrupts = <GIC_SPI 258 IRQ_TYPE_LEVEL_LOW>;
            clocks = <&camsys CLK_CAM_CAMSV0>,
                     <&camsys CLK_CAM_CAM>,
                     <&camsys CLK_CAM_CAMTG>;
            clock-names = "camsv", "cam", "camtg";
            power-domains = <&spm MT8183_POWER_DOMAIN_CAM>;
            mediatek,larb = <&larb6>, <&larb3>;
            memory-region = <&camsv_cma>;

            ports {
                #address-cells = <1>;
                #size-cells = <0>;

                port@0 {
                    reg = <0>;

                    endpoint {
                        remote-endpoint = <&seninf_mux0>;
                    };
                };
            };
        };
    };
...
```

## Documentation/devicetree/bindings/media/mediatek,mt8183-seninf.yaml
```yaml
# SPDX-License-Identifier: (GPL-2.0-only OR BSD-2-Clause)
%YAML 1.2
---
$id: http://devicetree.org/schemas/media/mediatek,mt8183-seninf.yaml#
$schema: http://devicetree.org/meta-schemas/core.yaml#

title: MediaTek SENINF MIPI CSI-2 receiver

maintainers:
  - Fredrik Lindlöf <fredrik.lindlof@gmail.com>

description:
  The SENINF block of the MediaTek MT8183 family (also MT6771) receives the
  MIPI CSI-2 streams of the camera sensors. The analog D-PHY receivers are
  separate PHY devices (mediatek,mt8365-csi-rx); SENINF has one decoder per
  CSI port and a set of muxes that route the decoded streams to the camera
  and CAMSV blocks. CSI0, CSI1 and CSI2 are 4 data lane ports; the two
  halves of CSI0 can alternatively be used as two 2 data lane ports, CSI0A
  and CSI0B.

properties:
  compatible:
    oneOf:
      - const: mediatek,mt8183-seninf
      - items:
          - const: mediatek,mt6771-seninf
          - const: mediatek,mt8183-seninf

  reg:
    maxItems: 1

  clocks:
    items:
      - description: SENINF gate in the camera system
      - description: SENINF mux in the top clock generator

  clock-names:
    items:
      - const: seninf
      - const: seninf_mux

  power-domains:
    maxItems: 1

  phys:
    minItems: 1
    maxItems: 5
    description:
      One PHY per CSI port that a sensor can be wired to, in the order of
      phy-names.

  phy-names:
    minItems: 1
    items:
      - const: csi0
      - const: csi1
      - const: csi2
      - const: csi0a
      - const: csi0b

  ports:
    $ref: /schemas/graph.yaml#/properties/ports

    patternProperties:
      '^port@[0-2]$':
        $ref: '#/$defs/csi-port'
        description:
          Input port with a 4 data lane sensor endpoint, CSI0, CSI1 or CSI2.

      '^port@[3-4]$':
        $ref: '#/$defs/csi-port'
        description:
          Input port with a 2 data lane sensor endpoint, CSI0A or CSI0B.
        properties:
          endpoint:
            type: object
            properties:
              data-lanes:
                maxItems: 2

    properties:
      port@5:
        $ref: /schemas/graph.yaml#/properties/port
        description: Output of MUX 0.

    anyOf:
      - required:
          - port@0
      - required:
          - port@1
      - required:
          - port@2
      - required:
          - port@3
      - required:
          - port@4

$defs:
  csi-port:
    $ref: /schemas/graph.yaml#/$defs/port-base
    unevaluatedProperties: false

    properties:
      endpoint:
        $ref: video-interfaces.yaml#
        unevaluatedProperties: false

        properties:
          bus-type:
            const: 4

          data-lanes:
            minItems: 1
            maxItems: 4
            items:
              enum: [1, 2, 3, 4]

        required:
          - data-lanes

required:
  - compatible
  - reg
  - clocks
  - clock-names
  - power-domains
  - phys
  - phy-names
  - ports

additionalProperties: false

examples:
  - |
    #include <dt-bindings/clock/mt8183-clk.h>
    #include <dt-bindings/phy/phy.h>
    #include <dt-bindings/power/mt8183-power.h>

    soc {
        #address-cells = <2>;
        #size-cells = <2>;

        csi@1a040000 {
            compatible = "mediatek,mt6771-seninf", "mediatek,mt8183-seninf";
            reg = <0 0x1a040000 0 0x8000>;
            clocks = <&camsys CLK_CAM_SENINF>,
                     <&topckgen CLK_TOP_MUX_SENINF>;
            clock-names = "seninf", "seninf_mux";
            power-domains = <&spm MT8183_POWER_DOMAIN_CAM>;
            phys = <&csi0_rx PHY_TYPE_DPHY 0>, <&csi1_rx>;
            phy-names = "csi0", "csi1";

            ports {
                #address-cells = <1>;
                #size-cells = <0>;

                port@0 {
                    reg = <0>;

                    endpoint {
                        remote-endpoint = <&main_camera_ep>;
                        bus-type = <4>;
                        data-lanes = <1 2 3 4>;
                    };
                };

                port@1 {
                    reg = <1>;

                    endpoint {
                        remote-endpoint = <&sub_camera_ep>;
                        bus-type = <4>;
                        data-lanes = <1 2>;
                    };
                };
            };
        };
    };
...
```

## Documentation/devicetree/bindings/net/mediatek,mt6771-md.yaml
```yaml
# SPDX-License-Identifier: (GPL-2.0-only OR BSD-2-Clause)
%YAML 1.2
---
$id: http://devicetree.org/schemas/net/mediatek,mt6771-md.yaml#
$schema: http://devicetree.org/meta-schemas/core.yaml#

title: MediaTek MT6771 integrated modem host interface

maintainers:
  - Fredrik Lindlöf <fredrik.lindlof@gmail.com>

description: |
  The AP side of the modem (MD1, generation 6293) built into the MediaTek
  MT6771. The AP talks to the modem through two blocks: CLDMA, a descriptor
  DMA engine split into an always-on and a power-down half, which carries
  the network queues; and CCIF, a mailbox with a 512-byte SRAM, which
  carries the boot handshake and the control channel.

  The bootloader loads and authenticates the modem firmware and describes
  what it loaded in /chosen; the operating system starts the modem and
  performs the handshake.

properties:
  compatible:
    const: mediatek,mt6771-md

  reg:
    items:
      - description: AP CLDMA, always-on half
      - description: AP CLDMA, power-down half
      - description: AP-side CCIF
      - description: MD-side CCIF
      - description: modem PLL block, written before the modem is released
      - description: modem clock switch
      - description: modem reset and watchdog block
      - description: modem boot control

  reg-names:
    items:
      - const: cldma-ao
      - const: cldma-pd
      - const: ap-ccif
      - const: md-ccif
      - const: md-pll
      - const: md-clksw
      - const: md-rgu
      - const: md-boot

  interrupts:
    items:
      - description: CLDMA queue events
      - description: CCIF channel events (handshake and ring queues)
      - description: CCIF events for the modem control path
      - description: modem watchdog

  interrupt-names:
    items:
      - const: cldma
      - const: ccif0
      - const: ccif1
      - const: wdt

  clocks:
    items:
      - description: CLDMA bus clock
      - description: CCIF0 AP side
      - description: CCIF0 MD side
      - description: CCIF1 AP side
      - description: CCIF1 MD side
      - description: CCIF2 AP side
      - description: CCIF2 MD side

  clock-names:
    items:
      - const: cldma
      - const: ccif-ap
      - const: ccif-md
      - const: ccif1-ap
      - const: ccif1-md
      - const: ccif2-ap
      - const: ccif2-md

  resets:
    items:
      - description: CLDMA always-on half
      - description: CLDMA power-down half
      - description: AP/MD CCIF

  reset-names:
    items:
      - const: cldma-ao
      - const: cldma-pd
      - const: ccif

  mediatek,scpsys:
    $ref: /schemas/types.yaml#/definitions/phandle
    description: The SPM, which holds the modem subsystem (MD1) power switch.

  mediatek,infracfg:
    $ref: /schemas/types.yaml#/definitions/phandle
    description: The bus protection between the AP and the modem, and the modem clock request.

  mediatek,topckgen:
    $ref: /schemas/types.yaml#/definitions/phandle
    description: The gates of the modem's reference clocks.

  mediatek,apmixedsys:
    $ref: /schemas/types.yaml#/definitions/phandle
    description: The filter of the 26 MHz reference the modem PLLs lock to.

required:
  - compatible
  - reg
  - reg-names
  - interrupts
  - interrupt-names
  - clocks
  - clock-names
  - mediatek,scpsys
  - mediatek,infracfg
  - mediatek,topckgen
  - mediatek,apmixedsys

additionalProperties: false

examples:
  - |
    #include <dt-bindings/clock/mt8183-clk.h>
    #include <dt-bindings/interrupt-controller/arm-gic.h>
    #include <dt-bindings/interrupt-controller/irq.h>
    #include <dt-bindings/reset/mt8183-resets.h>

    soc {
        #address-cells = <2>;
        #size-cells = <2>;

        modem@10014000 {
            compatible = "mediatek,mt6771-md";
            reg = <0 0x10014000 0 0x1000>,
                  <0 0x1021b000 0 0x1000>,
                  <0 0x10209000 0 0x1000>,
                  <0 0x1020a000 0 0x1000>,
                  <0 0x20140000 0 0x1000>,
                  <0 0x20150000 0 0x1000>,
                  <0 0x200f0000 0 0x1000>,
                  <0 0x20000000 0 0x1000>;
            reg-names = "cldma-ao", "cldma-pd", "ap-ccif", "md-ccif",
                        "md-pll", "md-clksw", "md-rgu", "md-boot";
            interrupts = <GIC_SPI 173 IRQ_TYPE_LEVEL_HIGH>,
                         <GIC_SPI 151 IRQ_TYPE_LEVEL_LOW>,
                         <GIC_SPI 152 IRQ_TYPE_LEVEL_LOW>,
                         <GIC_SPI 283 IRQ_TYPE_EDGE_FALLING>;
            interrupt-names = "cldma", "ccif0", "ccif1", "wdt";
            clocks = <&infracfg CLK_INFRA_CLDMA_BCLK>,
                     <&infracfg CLK_INFRA_CCIF_AP>,
                     <&infracfg CLK_INFRA_CCIF_MD>,
                     <&infracfg CLK_INFRA_CCIF1_AP>,
                     <&infracfg CLK_INFRA_CCIF1_MD>,
                     <&infracfg CLK_INFRA_CCIF2_AP>,
                     <&infracfg CLK_INFRA_CCIF2_MD>;
            clock-names = "cldma", "ccif-ap", "ccif-md", "ccif1-ap",
                          "ccif1-md", "ccif2-ap", "ccif2-md";
            resets = <&infracfg MT8183_INFRACFG_AO_CLDMA_AO_SW_RST>,
                     <&infracfg MT8183_INFRACFG_AO_CLDMA_SW_RST>,
                     <&infracfg MT8183_INFRACFG_AO_AP_MD_CCIF_SW_RST>;
            reset-names = "cldma-ao", "cldma-pd", "ccif";
            mediatek,scpsys = <&scpsys>;
            mediatek,infracfg = <&infracfg>;
            mediatek,topckgen = <&topckgen>;
            mediatek,apmixedsys = <&apmixedsys>;
        };
    };
```

## Documentation/devicetree/bindings/power/supply/mediatek,mt6358-battery.yaml
```yaml
# SPDX-License-Identifier: (GPL-2.0-only OR BSD-2-Clause)
%YAML 1.2
---
$id: http://devicetree.org/schemas/power/supply/mediatek,mt6358-battery.yaml#
$schema: http://devicetree.org/meta-schemas/core.yaml#

title: MediaTek MT6358 fuel gauge

maintainers:
  - Fredrik Lindlöf <fredrik.lindlof@gmail.com>

description:
  Coulomb counter and current sense of the MT6358 PMIC, a child of the PMIC
  node. The state of charge is estimated from the monitored battery's OCV
  table and then followed with the coulomb counter.

allOf:
  - $ref: power-supply.yaml#

properties:
  compatible:
    const: mediatek,mt6358-battery

  io-channels:
    maxItems: 1

  io-channel-names:
    const: vbat

  monitored-battery: true

required:
  - compatible
  - io-channels
  - io-channel-names
  - monitored-battery

unevaluatedProperties: false

examples:
  - |
    battery {
        compatible = "mediatek,mt6358-battery";
        io-channels = <&pmic_adc 0>;
        io-channel-names = "vbat";
        monitored-battery = <&bat>;
    };
```

## Documentation/devicetree/bindings/soc/mediatek/mediatek,mt6771-mcdi.yaml
```yaml
# SPDX-License-Identifier: (GPL-2.0-only OR BSD-2-Clause)
%YAML 1.2
---
$id: http://devicetree.org/schemas/soc/mediatek/mediatek,mt6771-mcdi.yaml#
$schema: http://devicetree.org/meta-schemas/core.yaml#

title: MediaTek MT6771 SSPM multi-core deep idle (MCDI) mailbox

maintainers:
  - Fredrik Lindlöf <fredrik.lindlof@gmail.com>

description:
  Mailbox 3 of the MT6771 SSPM, through which the kernel tells the SSPM MCDI firmware task
  which CPU cores it may power off in idle, and the SRAM area where that task keeps its
  statistics.

properties:
  compatible:
    const: mediatek,mt6771-mcdi

  reg:
    minItems: 1
    items:
      - description: SSPM mailbox 3
      - description: MCDI statistics SRAM

  reg-names:
    minItems: 1
    items:
      - const: mbox
      - const: sysram

required:
  - compatible
  - reg
  - reg-names

additionalProperties: false

examples:
  - |
    soc {
        #address-cells = <2>;
        #size-cells = <2>;

        mcdi@10480000 {
            compatible = "mediatek,mt6771-mcdi";
            reg = <0 0x10480000 0 0x100>, <0 0x0011b000 0 0x800>;
            reg-names = "mbox", "sysram";
        };
    };
```
