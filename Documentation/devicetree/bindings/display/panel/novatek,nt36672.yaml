## drivers/net/wwan/mtk_md/Kconfig
```kconfig
# SPDX-License-Identifier: GPL-2.0-only

config MTK_MD
	tristate "MediaTek MT6771 integrated modem"
	depends on ARCH_MEDIATEK || COMPILE_TEST
	depends on OF && HAS_IOMEM && COMMON_CLK
	select MTK_MD_PROTO
	help
	  Host side of the modem built into the MediaTek MT6771 (Helio P60/P70),
	  MD generation 6293. The bootloader loads the modem firmware; this
	  driver maps the CLDMA and CCIF blocks the AP talks to the modem
	  through, reads what the bootloader loaded, and performs the start
	  handshake.

	  This is a skeleton: it logs every step of the start sequence but
	  does not yet power the modem on and offers no network interface.

	  If unsure, say N.

config MTK_MD_PROTO
	tristate

config MTK_CONN_MD
	tristate "MediaTek connsys/modem message bridge (LTE coexistence)"
	depends on ARCH_MEDIATEK || COMPILE_TEST
	help
	  Routes the in-device coexistence (IDC) messages between the
	  MT6771 modem and the CONNSYS Wi-Fi/Bluetooth core, as the
	  vendor's conn_md does: the modem driver relays its LTE layer's
	  IPC messages, the CONNSYS WMT core turns them into firmware
	  commands and sends the firmware's Wi-Fi/Bluetooth channel
	  reports back. Without it both radios work, uncoordinated.

	  If unsure, say N.

config MTK_MD_KUNIT_TEST
	tristate "KUnit tests for the MT6771 modem protocol" if !KUNIT_ALL_TESTS
	depends on KUNIT
	select MTK_MD_PROTO
	default KUNIT_ALL_TESTS
	help
	  Tests for the parts of the MT6771 modem driver that are pure data:
	  the bootloader's information block, the CCCI header and the runtime
	  feature negotiation. They run without hardware.

	  If unsure, say N.
```

## drivers/soc/mediatek/Kconfig
```kconfig
# SPDX-License-Identifier: GPL-2.0-only
#
# MediaTek SoC drivers
#
menu "MediaTek SoC drivers"
	depends on ARCH_MEDIATEK || COMPILE_TEST

config MTK_CMDQ
	tristate "MediaTek CMDQ Support"
	depends on ARCH_MEDIATEK || COMPILE_TEST
	select MAILBOX
	select MTK_CMDQ_MBOX
	select MTK_INFRACFG
	help
	  Say yes here to add support for the MediaTek Command Queue (CMDQ)
	  driver. The CMDQ is used to help read/write registers with critical
	  time limitation, such as updating display configuration during the
	  vblank.

config MTK_DEVAPC
	tristate "Mediatek Device APC Support"
	help
	  Say yes here to enable support for Mediatek Device APC driver.
	  This driver is mainly used to handle the violation which catches
	  unexpected transaction.
	  The violation information is logged for further analysis or
	  countermeasures.

config MTK_DVFSRC
	tristate "MediaTek DVFSRC Support"
	depends on ARCH_MEDIATEK
	help
	  Say yes here to add support for the MediaTek Dynamic Voltage
	  and Frequency Scaling Resource Collector (DVFSRC): a HW
	  IP found on many MediaTek SoCs, which is responsible for
	  collecting DVFS requests from various SoC IPs, other than
	  software, and performing bandwidth scaling to provide the
	  best achievable performance-per-watt.

config MTK_INFRACFG
	bool "MediaTek INFRACFG Support"
	select REGMAP
	help
	  Say yes here to add support for the MediaTek INFRACFG controller. The
	  INFRACFG controller contains various infrastructure registers not
	  directly associated to any device.

config MTK_PMIC_WRAP
	tristate "MediaTek PMIC Wrapper Support"
	depends on RESET_CONTROLLER
	depends on OF
	select REGMAP
	help
	  Say yes here to add support for MediaTek PMIC Wrapper found
	  on different MediaTek SoCs. The PMIC wrapper is a proprietary
	  hardware to connect the PMIC.

config MTK_REGULATOR_COUPLER
	bool "MediaTek SoC Regulator Coupler" if COMPILE_TEST
	default ARCH_MEDIATEK
	depends on REGULATOR

config MTK_MMSYS
	tristate "MediaTek MMSYS Support"
	default ARCH_MEDIATEK
	depends on HAS_IOMEM
	depends on MTK_CMDQ || MTK_CMDQ=n
	help
	  Say yes here to add support for the MediaTek Multimedia
	  Subsystem (MMSYS).

config MTK_SVS
	tristate "MediaTek Smart Voltage Scaling(SVS)"
	depends on NVMEM_MTK_EFUSE && NVMEM
	help
	  The Smart Voltage Scaling(SVS) engine is a piece of hardware
	  which has several controllers(banks) for calculating suitable
	  voltage to different power domains(CPU/GPU/CCI) according to
	  chip process corner, temperatures and other factors. Then DVFS
	  driver could apply SVS bank voltage to PMIC/Buck.

config MTK_SOCINFO
	tristate "MediaTek SoC Information"
	default y
	depends on NVMEM_MTK_EFUSE
	select SOC_BUS
	help
	  The MediaTek SoC Information (mtk-socinfo) driver provides
	  information about the SoC to the userspace including the
	  manufacturer name, marketing name and soc name.

config MTK_MT6771_CPU_PM
	bool "MediaTek MT6771 core power-down after hotplug"
	depends on ARM64 && HOTPLUG_CPU
	help
	  On MT6771 the firmware's PSCI CPU_OFF does not cut a core's power; the kernel must ask
	  for it with a SiP call once the core is dead, or the core can never be brought back
	  (hotplug and kexec both lose it). Say Y on MT6771 boards.

config MTK_MT6771_MCDI
	bool "MediaTek MT6771 SSPM multi-core deep idle"
	depends on ARM64 && CPU_IDLE && HOTPLUG_CPU && OF
	help
	  Writes the SSPM MCDI mailbox init the MT6771 firmware relies on before a PSCI
	  core-off idle state is used, keeps it current across CPU hotplug, and keeps the
	  DT's deep idle states disabled until mtk_mt6771_mcdi.idle_cpus allows them.
	  Built in so that this gate exists before the PSCI cpuidle driver registers.

config MTK_MT6771_MCDI_KUNIT_TEST
	tristate "KUnit tests for the MT6771 MCDI helpers" if !KUNIT_ALL_TESTS
	depends on KUNIT
	default KUNIT_ALL_TESTS

config MTK_MT6771_SLEEP
	tristate "MediaTek MT6771 SPM deep sleep"
	depends on ARM64 && SUSPEND && MTK_MT6771_MCDI && MFD_SYSCON && OF
	help
	  Arms the MT6771 SPM suspend firmware around PSCI SYSTEM_SUSPEND, as the vendor kernel
	  does around its own suspend entry: SSPM notification, SPM flags and wake timer, MCDI
	  task pause, and optionally the MT6358 low-power rail table. Does nothing until
	  mtk_mt6771_sleep.deep_enable is set and "deep" is chosen in /sys/power/mem_sleep.

config MTK_MT6771_SLEEP_KUNIT_TEST
	tristate "KUnit tests for the MT6771 deep sleep helpers" if !KUNIT_ALL_TESTS
	depends on KUNIT
	default KUNIT_ALL_TESTS

endmenu
```
