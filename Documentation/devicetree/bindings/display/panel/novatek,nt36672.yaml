## Documentation/devicetree/bindings/display/panel/novatek,nt36672.yaml
```yaml
# SPDX-License-Identifier: (GPL-2.0-only OR BSD-2-Clause)
%YAML 1.2
---
$id: http://devicetree.org/schemas/display/panel/novatek,nt36672.yaml#
$schema: http://devicetree.org/meta-schemas/core.yaml#

title: Novatek NT36672 based DSI display panels

maintainers:
  - Fredrik Lindlöf <fredrik.lindlof@gmail.com>

description:
  The NT36672 is a Novatek display driver IC for MIPI DSI LCD panels. The
  initialisation sequence belongs to the panel built around it rather than to
  the IC, so each panel is described by its own compatible.

allOf:
  - $ref: panel-common.yaml#

properties:
  compatible:
    enum:
      # 6.0" 1080x2160 video mode LCD in the Planet Computers Cosmo Communicator
      - planet,cosmocom-nt36672

  reg:
    maxItems: 1

  vddi-supply:
    description: I/O voltage supply (1.8 V)

  avdd-supply:
    description: Positive analog supply for the source drivers

  avee-supply:
    description: Negative analog supply for the source drivers

  reset-gpios:
    maxItems: 1

required:
  - compatible
  - reg
  - vddi-supply
  - avdd-supply
  - avee-supply
  - reset-gpios
  - port

unevaluatedProperties: false

examples:
  - |
    #include <dt-bindings/gpio/gpio.h>

    dsi {
        #address-cells = <1>;
        #size-cells = <0>;

        panel@0 {
            compatible = "planet,cosmocom-nt36672";
            reg = <0>;

            vddi-supply = <&vio18>;
            avdd-supply = <&dsv_pos>;
            avee-supply = <&dsv_neg>;
            reset-gpios = <&pio 45 GPIO_ACTIVE_LOW>;
            backlight = <&wled>;
            rotation = <270>;

            port {
                endpoint {
                    remote-endpoint = <&dsi_out>;
                };
            };
        };
    };

...
```

## Documentation/devicetree/bindings/iio/magnetometer/voltafield,af6133e.yaml
```yaml
# SPDX-License-Identifier: (GPL-2.0 OR BSD-2-Clause)
%YAML 1.2
---
$id: http://devicetree.org/schemas/iio/magnetometer/voltafield,af6133e.yaml#
$schema: http://devicetree.org/meta-schemas/core.yaml#

title: Voltafield AF6133E magnetometer sensor

maintainers:
  - Fredrik Lindlöf <fredrik.lindlof@gmail.com>

properties:
  compatible:
    const: voltafield,af6133e

  reg:
    maxItems: 1

  vdd-supply:
    description: Regulator for the sensor supply.

  vddio-supply:
    description: Regulator for the digital I/O supply.

  mount-matrix:
    description: An optional 3x3 mounting rotation matrix.

required:
  - compatible
  - reg

additionalProperties: false

examples:
  - |
    i2c {
        #address-cells = <1>;
        #size-cells = <0>;

        magnetometer@c {
            compatible = "voltafield,af6133e";
            reg = <0x0c>;
        };
    };
```

## Documentation/devicetree/bindings/input/linux,fn-power-combiner.yaml
```yaml
# SPDX-License-Identifier: GPL-2.0-only OR BSD-2-Clause
%YAML 1.2
---
$id: http://devicetree.org/schemas/input/linux,fn-power-combiner.yaml#
$schema: http://devicetree.org/meta-schemas/core.yaml#

title: Fn + power-line key combiner

maintainers:
  - Fredrik Lindlöf <fredrik.lindlof@gmail.com>

description: |
  Some keyboards wire the power-key line of the PMIC to a key of the keyboard
  (Esc on the Planet Cosmo Communicator), so that the line key has to double as
  Esc and as power. The combiner attaches to the keyboard input device and to
  the input device that reports the line key. A press of the line key made
  while the Fn key is held is reported as KEY_POWER on an input device of the
  combiner and the line event is dropped; otherwise the line key event reaches
  user space unchanged. Once a press is power, it stays power until its
  release, whatever Fn does in between.

  The devices are found by the node of the device that registered them, that
  is the node of the platform device that owns the input device.

  Wake-up from suspend is not handled here: the line key stays a wake source
  of its own driver. The Fn state is tracked from keyboard events, so Fn must
  have been pressed while the keyboard was being scanned.

  If a lid switch is given, every event of the keyboard is dropped while the
  switch reports closed, keys that were held are released, and the Fn state is
  read again when the lid opens.

properties:
  compatible:
    const: linux,fn-power-combiner

  keyboard:
    $ref: /schemas/types.yaml#/definitions/phandle
    description: Node of the device that registers the keyboard input device.

  power-key:
    $ref: /schemas/types.yaml#/definitions/phandle
    description: Node of the device that registers the input device of the line key.

  lid-switch:
    $ref: /schemas/types.yaml#/definitions/phandle
    description:
      Node of the device that registers an input device with SW_LID. The
      keyboard is muted while it reports closed.

  linux,fn-code:
    $ref: /schemas/types.yaml#/definitions/uint32
    default: 125
    description: Key code of the Fn key on the keyboard (KEY_LEFTMETA).

  linux,line-code:
    $ref: /schemas/types.yaml#/definitions/uint32
    default: 1
    description: Key code the line key reports on its input device (KEY_ESC).

required:
  - compatible
  - keyboard
  - power-key

additionalProperties: false

examples:
  - |
    kbd: keyboard {
    };

    pmic_keys: pmic-keys {
    };

    lid_keys: lid-keys {
    };

    fn-power {
        compatible = "linux,fn-power-combiner";
        keyboard = <&kbd>;
        power-key = <&pmic_keys>;
        lid-switch = <&lid_keys>;
    };
```

## Documentation/devicetree/bindings/leds/awinic,aw9524.yaml
```yaml
# SPDX-License-Identifier: (GPL-2.0-only OR BSD-2-Clause)
%YAML 1.2
---
$id: http://devicetree.org/schemas/leds/awinic,aw9524.yaml#
$schema: http://devicetree.org/meta-schemas/core.yaml#

title: Awinic AW9523B/AW9524 in LED mode

maintainers:
  - Fredrik Lindlöf <fredrik.lindlof@gmail.com>

description:
  The AW9523B/AW9524 16-pin I/O expanders can drive each pin as a
  constant-current LED sink with 256 dimming steps. Pins described as LED
  child nodes are switched to LED mode; P0_0..P0_7 are pins 0-7 and
  P1_0..P1_7 are pins 8-15.

properties:
  compatible:
    const: awinic,aw9524

  reg:
    maxItems: 1

  reset-gpios:
    maxItems: 1

  awinic,led-max-microamp:
    description: Full-scale current of all LED pins.
    enum: [37000, 27750, 18500, 9250]
    default: 37000

  "#address-cells":
    const: 1

  "#size-cells":
    const: 0

patternProperties:
  "^led@[0-9a-f]$":
    type: object
    $ref: common.yaml#
    unevaluatedProperties: false
    properties:
      reg:
        maximum: 15
    required:
      - reg

required:
  - compatible
  - reg

additionalProperties: false

examples:
  - |
    #include <dt-bindings/gpio/gpio.h>
    #include <dt-bindings/leds/common.h>
    i2c {
        #address-cells = <1>;
        #size-cells = <0>;

        led-controller@5b {
            compatible = "awinic,aw9524";
            reg = <0x5b>;
            reset-gpios = <&gpio 109 GPIO_ACTIVE_LOW>;
            awinic,led-max-microamp = <18500>;
            #address-cells = <1>;
            #size-cells = <0>;

            led@0 {
                reg = <0>;
                color = <LED_COLOR_ID_RED>;
                function = LED_FUNCTION_INDICATOR;
            };
        };
    };
```

## Documentation/devicetree/bindings/media/i2c/galaxycore,gc5035.yaml
```yaml
# SPDX-License-Identifier: (GPL-2.0-only OR BSD-2-Clause)
%YAML 1.2
---
$id: http://devicetree.org/schemas/media/i2c/galaxycore,gc5035.yaml#
$schema: http://devicetree.org/meta-schemas/core.yaml#

title: GalaxyCore GC5035 5M Pixel MIPI CSI-2 sensor

maintainers:
  - Fredrik Lindlöf <fredrik.lindlof@gmail.com>

description:
  The GC5035 is a 2592x1944 raw Bayer image sensor with a two lane MIPI CSI-2
  interface and a CCI (I2C compatible) control bus.

allOf:
  - $ref: /schemas/media/video-interface-devices.yaml#

properties:
  compatible:
    const: galaxycore,gc5035

  reg:
    maxItems: 1

  clocks:
    maxItems: 1
    description: Master clock, 24 MHz.

  dovdd-supply:
    description: Digital I/O supply, 1.8 V.

  avdd-supply:
    description: Analog supply, 2.8 V.

  dvdd-supply:
    description: Digital core supply, 1.2 V.

  reset-gpios:
    description:
      Reference to the GPIO connected to the reset pin. Asserted holds the
      sensor in reset.
    maxItems: 1

  powerdown-gpios:
    description:
      Reference to the GPIO connected to the power down pin. Asserted powers
      the sensor down; on boards where the pin is high in operation use
      GPIO_ACTIVE_LOW.
    maxItems: 1

  port:
    $ref: /schemas/graph.yaml#/$defs/port-base
    additionalProperties: false
    description:
      Output port node, single endpoint describing the CSI-2 transmitter.

    properties:
      endpoint:
        $ref: /schemas/media/video-interfaces.yaml#
        unevaluatedProperties: false

        properties:
          data-lanes:
            items:
              - const: 1
              - const: 2

          link-frequencies: true

        required:
          - data-lanes
          - link-frequencies

    required:
      - endpoint

required:
  - compatible
  - reg
  - clocks
  - dovdd-supply
  - avdd-supply
  - dvdd-supply
  - reset-gpios
  - powerdown-gpios
  - port

unevaluatedProperties: false

examples:
  - |
    #include <dt-bindings/gpio/gpio.h>

    i2c {
        #address-cells = <1>;
        #size-cells = <0>;

        sensor@37 {
            compatible = "galaxycore,gc5035";
            reg = <0x37>;

            clocks = <&gc5035_clk>;

            reset-gpios = <&pio 102 GPIO_ACTIVE_LOW>;
            powerdown-gpios = <&pio 98 GPIO_ACTIVE_LOW>;

            dovdd-supply = <&gc5035_dovdd>;
            avdd-supply = <&gc5035_avdd>;
            dvdd-supply = <&gc5035_dvdd>;

            port {
                sensor_out: endpoint {
                    data-lanes = <1 2>;
                    link-frequencies = /bits/ 64 <438000000 219000000>;
                    remote-endpoint = <&csi_in>;
                };
            };
        };
    };

...
```

## Documentation/devicetree/bindings/media/i2c/samsung,s5k2x7.yaml
```yaml
# SPDX-License-Identifier: (GPL-2.0-only OR BSD-2-Clause)
%YAML 1.2
---
$id: http://devicetree.org/schemas/media/i2c/samsung,s5k2x7.yaml#
$schema: http://devicetree.org/meta-schemas/core.yaml#

title: Samsung S5K2X7 Image Sensor

description:
  Samsung S5K2X7 (ISOCELL 2X7) image sensor is a 24MP raw image sensor with
  a 5664x4256 pixel array. The sensor is controlled over a serial camera
  control bus protocol, data output format is RAW10 transferred over a
  4-lane MIPI D-PHY interface.

maintainers:
  - Fredrik Lindlöf <fredrik.lindlof@gmail.com>

allOf:
  - $ref: /schemas/media/video-interface-devices.yaml#

properties:
  compatible:
    const: samsung,s5k2x7

  reg:
    maxItems: 1

  clocks:
    description: MCLK supply clock, 24 MHz.
    maxItems: 1

  reset-gpios:
    description:
      GPIO connected to the reset pad of the sensor. Asserted holds the
      sensor in reset.
    maxItems: 1

  powerdown-gpios:
    description:
      GPIO connected to the power down pad of the sensor. Asserted powers the
      sensor down; on boards where the pad is high in operation use
      GPIO_ACTIVE_LOW.
    maxItems: 1

  avdd-supply:
    description: Analogue voltage supply, 2.8 volts.

  dovdd-supply:
    description: Digital I/O voltage supply, 1.8 volts.

  dvdd-supply:
    description: Digital core voltage supply, 1.0 volts.

  afvdd-supply:
    description: Autofocus actuator voltage supply, 2.8 volts.

  port:
    $ref: /schemas/graph.yaml#/$defs/port-base
    additionalProperties: false

    properties:
      endpoint:
        $ref: /schemas/media/video-interfaces.yaml#
        unevaluatedProperties: false

        properties:
          data-lanes:
            items:
              - const: 1
              - const: 2
              - const: 3
              - const: 4

        required:
          - data-lanes
          - link-frequencies

required:
  - compatible
  - reg
  - clocks
  - reset-gpios
  - powerdown-gpios
  - avdd-supply
  - dovdd-supply
  - dvdd-supply
  - port

unevaluatedProperties: false

examples:
  - |
    #include <dt-bindings/gpio/gpio.h>

    i2c {
        #address-cells = <1>;
        #size-cells = <0>;

        camera@10 {
            compatible = "samsung,s5k2x7";
            reg = <0x10>;
            clocks = <&camera_mclk 0>;
            assigned-clocks = <&camera_mclk 0>;
            assigned-clock-rates = <24000000>;
            reset-gpios = <&gpio1 10 GPIO_ACTIVE_LOW>;
            powerdown-gpios = <&gpio1 11 GPIO_ACTIVE_LOW>;
            avdd-supply = <&vreg_2p8>;
            dovdd-supply = <&vreg_1p8>;
            dvdd-supply = <&vreg_1p0>;
            afvdd-supply = <&vreg_af>;

            port {
                endpoint {
                    data-lanes = <1 2 3 4>;
                    link-frequencies = /bits/ 64 <798000000>;
                    remote-endpoint = <&mipi_csi2_ep>;
                };
            };
        };
    };
...
```
