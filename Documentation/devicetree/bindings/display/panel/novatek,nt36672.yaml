## Documentation/devicetree/bindings/soc/mediatek/mediatek,mt6771-sleep.yaml
```yaml
# SPDX-License-Identifier: (GPL-2.0-only OR BSD-2-Clause)
%YAML 1.2
---
$id: http://devicetree.org/schemas/soc/mediatek/mediatek,mt6771-sleep.yaml#
$schema: http://devicetree.org/meta-schemas/core.yaml#

title: MediaTek MT6771 SPM deep sleep

maintainers:
  - Fredrik Lindlöf <fredrik.lindlof@gmail.com>

description:
  System suspend support for MT6771. The kernel notifies the SSPM firmware through mailbox 1
  before and after suspend, and arms the SPM suspend firmware through the trusted firmware.
  The node names that mailbox, the SPM register block and the PMIC whose rail low-power
  modes the SPM firmware relies on.

properties:
  compatible:
    const: mediatek,mt6771-sleep

  reg:
    items:
      - description: SSPM mailbox 1 data
      - description: SSPM mailbox 1 interrupt control

  reg-names:
    items:
      - const: mbox
      - const: mbox-ctrl

  mediatek,spm:
    $ref: /schemas/types.yaml#/definitions/phandle
    description: The SPM (scpsys) syscon

  mediatek,pmic:
    $ref: /schemas/types.yaml#/definitions/phandle
    description: The MT6358 PMIC

required:
  - compatible
  - reg
  - reg-names
  - mediatek,spm
  - mediatek,pmic

additionalProperties: false

examples:
  - |
    soc {
        #address-cells = <2>;
        #size-cells = <2>;

        sleep@10460000 {
            compatible = "mediatek,mt6771-sleep";
            reg = <0 0x10460000 0 0x100>, <0 0x10461000 0 0x8>;
            reg-names = "mbox", "mbox-ctrl";
            mediatek,spm = <&scpsys>;
            mediatek,pmic = <&pmic>;
        };
    };
```

## Documentation/devicetree/bindings/sound/mediatek,mt6358-accdet.yaml
```yaml
# SPDX-License-Identifier: (GPL-2.0-only OR BSD-2-Clause)
%YAML 1.2
---
$id: http://devicetree.org/schemas/sound/mediatek,mt6358-accdet.yaml#
$schema: http://devicetree.org/meta-schemas/core.yaml#

title: MediaTek MT6358 accessory detection

maintainers:
  - Fredrik Lindlöf <fredrik.lindlof@gmail.com>

description:
  Headset jack and button detection block of the MT6358 PMIC, a child of the
  PMIC node. The plug is reported by the ACCDET EINT0 line, the plug type and
  button presses by the ACCDET comparator, and the buttons are told apart by
  the AUXADC ACCDET channel.

properties:
  compatible:
    const: mediatek,mt6358-accdet

  io-channels:
    maxItems: 1

  io-channel-names:
    const: accdet

  mediatek,mic-vol:
    $ref: /schemas/types.yaml#/definitions/uint32
    description: MICBIAS1 voltage selector, AUDENC_ANA_CON10 bits 6:4.
    maximum: 7

  mediatek,eint-level-pol:
    $ref: /schemas/types.yaml#/definitions/uint32
    description: Plug-in level of the EINT line, an IRQ_TYPE_LEVEL_* value.
    enum: [4, 8]

  mediatek,pwm-deb-setting:
    $ref: /schemas/types.yaml#/definitions/uint32-array
    description:
      PWM width, PWM threshold, fall delay, rise delay, then the debounce
      times of comparator states 00, 01 and 11 and of the AUXADC.
    minItems: 8
    maxItems: 8

  mediatek,three-key-thr:
    $ref: /schemas/types.yaml#/definitions/uint32-array
    description:
      Button voltage boundaries in mV; the first cell is unused, then the
      upper limits of play/pause, volume up and volume down.
    minItems: 4
    maxItems: 4

required:
  - compatible
  - io-channels
  - io-channel-names
  - mediatek,pwm-deb-setting
  - mediatek,three-key-thr

additionalProperties: false

examples:
  - |
    accdet {
        compatible = "mediatek,mt6358-accdet";
        io-channels = <&pmic_adc 4>;
        io-channel-names = "accdet";
        mediatek,mic-vol = <6>;
        mediatek,eint-level-pol = <8>;
        mediatek,pwm-deb-setting = <0x500 0x500 1 0x1f0 0x800 0x800 0x20 0x44>;
        mediatek,three-key-thr = <0 80 220 400>;
    };
```

## Documentation/devicetree/bindings/sound/planet,cosmo-sound.yaml
```yaml
# SPDX-License-Identifier: (GPL-2.0-only OR BSD-2-Clause)
%YAML 1.2
---
$id: http://devicetree.org/schemas/sound/planet,cosmo-sound.yaml#
$schema: http://devicetree.org/meta-schemas/core.yaml#

title: Planet Cosmo Communicator sound card

maintainers:
  - Fredrik Lindlöf <fredrik.lindlof@gmail.com>

description:
  MT6771 audio front end with the MT6358 codec. The speakers are driven from
  the codec headphone buffer through GPIO amplifiers, and the earpiece path
  has a GPIO switch.

properties:
  compatible:
    const: planet,cosmo-sound

  mediatek,platform:
    $ref: /schemas/types.yaml#/definitions/phandle
    description: The audio front end.

  mediatek,accdet:
    $ref: /schemas/types.yaml#/definitions/phandle
    description: The MT6358 accessory detection block, for the headset jack.

  aux-devs:
    $ref: /schemas/types.yaml#/definitions/phandle-array
    items:
      maxItems: 1
    description:
      Amplifiers and switches on the codec outputs. Their sound-name-prefix
      must be "Amp1" and "Amp2" for the speaker amplifiers and
      "Earpiece Switch" for the earpiece switch.

  pinctrl-names:
    const: default

  pinctrl-0:
    maxItems: 1

required:
  - compatible
  - mediatek,platform

additionalProperties: false

examples:
  - |
    sound {
        compatible = "planet,cosmo-sound";
        mediatek,platform = <&afe>;
        aux-devs = <&amp1>, <&amp2>, <&earpiece_switch>;
    };
```

## Documentation/devicetree/bindings/usb/fcs,fusb301.yaml
```yaml
# SPDX-License-Identifier: (GPL-2.0-only OR BSD-2-Clause)
%YAML 1.2
---
$id: http://devicetree.org/schemas/usb/fcs,fusb301.yaml#
$schema: http://devicetree.org/meta-schemas/core.yaml#

title: Fairchild FUSB301 Type-C port controller

description:
  The Fairchild (onsemi) FUSB301 is a USB Type-C port controller which
  supports role and plug orientation detection using the CC pins. It is
  compatible with the USB Type-C Cable and Connector Specification v1.2.

maintainers:
  - Fredrik Lindlöf <fredrik.lindlof@gmail.com>

properties:
  compatible:
    enum:
      - fcs,fusb301

  reg:
    maxItems: 1

  interrupts:
    maxItems: 1

  vbus-supply:
    description:
      Regulator that provides VBUS when the port is a source. Omit it when
      VBUS is switched by other hardware.

  fcs,vbus-on-unless-source:
    type: boolean
    description:
      Keep vbus-supply enabled while no partner or a sink partner is
      attached, and release it only while a source partner is attached. For
      a rail that also feeds other loads on the board. The partner type is
      polled, since a source partner may not raise an interrupt.

  hdmi-detect-gpios:
    maxItems: 1
    description:
      Input that an HDMI adapter drives active once VBUS is up. It is read
      400 ms after a sink partner attaches; while it is active the port takes
      no USB data role.

  source-notify-gpios:
    maxItems: 1
    description:
      Output driven active while a source partner (charger or host) is
      attached, for a companion controller.

  connector:
    type: object
    $ref: ../connector/usb-connector.yaml#
    unevaluatedProperties: false
    description:
      The managed USB Type-C connector. Since FUSB301 does not support
      Power Delivery, the node should have the "pd-disable" property. A
      graph link from port@0 to a USB role switch lets the driver switch
      the controller to host when a sink is attached.

    properties:
      compatible:
        const: usb-c-connector

    required:
      - pd-disable

required:
  - compatible
  - reg
  - interrupts
  - connector

additionalProperties: false

examples:
  - |
    #include <dt-bindings/gpio/gpio.h>
    #include <dt-bindings/interrupt-controller/irq.h>

    i2c {
      #address-cells = <1>;
      #size-cells = <0>;

      tcpc@25 {
        compatible = "fcs,fusb301";
        reg = <0x25>;
        interrupt-parent = <&gpio0>;
        interrupts = <4 IRQ_TYPE_LEVEL_LOW>;
        vbus-supply = <&otg_switch>;
        fcs,vbus-on-unless-source;
        hdmi-detect-gpios = <&gpio0 54 GPIO_ACTIVE_HIGH>;
        source-notify-gpios = <&gpio0 52 GPIO_ACTIVE_HIGH>;

        connector {
          compatible = "usb-c-connector";
          label = "USB-C";
          power-role = "dual";
          try-power-role = "sink";
          data-role = "dual";
          typec-power-opmode = "default";
          pd-disable;
        };
      };
    };
```

## Documentation/devicetree/bindings/usb/gpio-usb-role-mux.yaml
```yaml
# SPDX-License-Identifier: (GPL-2.0-only OR BSD-2-Clause)
%YAML 1.2
---
$id: http://devicetree.org/schemas/usb/gpio-usb-role-mux.yaml#
$schema: http://devicetree.org/meta-schemas/core.yaml#

title: GPIO USB role switch multiplexer

maintainers:
  - Fredrik Lindlöf <fredrik.lindlof@gmail.com>

description:
  One dual-role USB controller shared by two connectors. A GPIO-controlled
  analog switch routes the USB 2.0 data lines to one connector at a time.
  Each input is a USB role switch for that connector's port controller;
  the output port links to the controller's own role switch.

properties:
  compatible:
    const: gpio-usb-role-mux

  select-gpios:
    maxItems: 1
    description: Low routes the lines to input 0, high to input 1.

  port:
    $ref: /schemas/graph.yaml#/properties/port
    description: Link to the USB controller, which is a USB role switch.

  '#address-cells':
    const: 1

  '#size-cells':
    const: 0

patternProperties:
  '^input@[01]$':
    type: object
    additionalProperties: false

    properties:
      reg:
        maximum: 1

      label:
        description: Name of the connector, used in sysfs.

      usb-role-switch: true

      port:
        $ref: /schemas/graph.yaml#/properties/port
        description: Link to the connector.

    required:
      - reg
      - usb-role-switch
      - port

required:
  - compatible
  - select-gpios
  - port
  - '#address-cells'
  - '#size-cells'
  - input@0
  - input@1

additionalProperties: false

examples:
  - |
    #include <dt-bindings/gpio/gpio.h>

    usb-role-mux {
      compatible = "gpio-usb-role-mux";
      select-gpios = <&pio 79 GPIO_ACTIVE_HIGH>;
      #address-cells = <1>;
      #size-cells = <0>;

      port {
        endpoint {
          remote-endpoint = <&usb_hs_ep>;
        };
      };

      input@0 {
        reg = <0>;
        label = "left";
        usb-role-switch;

        port {
          endpoint {
            remote-endpoint = <&left_hs_ep>;
          };
        };
      };

      input@1 {
        reg = <1>;
        label = "right";
        usb-role-switch;

        port {
          endpoint {
            remote-endpoint = <&right_hs_ep>;
          };
        };
      };
    };
```

## drivers/media/platform/mediatek/camsv/Kconfig
```kconfig
# SPDX-License-Identifier: GPL-2.0-only
config VIDEO_MEDIATEK_CAMSV
	tristate "MediaTek CAMSV raw capture"
	depends on V4L_PLATFORM_DRIVERS
	depends on VIDEO_DEV && OF
	depends on ARCH_MEDIATEK || COMPILE_TEST
	depends on PM
	select MEDIA_CONTROLLER
	select V4L2_FWNODE
	select VIDEO_V4L2_SUBDEV_API
	select VIDEOBUF2_DMA_CONTIG
	help
	  Support for the CAMSV raw capture units of the MediaTek MT8183
	  family (also MT6771). A CAMSV unit takes the stream of one SENINF
	  mux and writes the raw Bayer frames to memory.

	  To compile this driver as a module, choose M here: the module will
	  be called mtk-camsv.
```

## drivers/media/platform/mediatek/seninf/Kconfig
```kconfig
# SPDX-License-Identifier: GPL-2.0-only
config VIDEO_MEDIATEK_SENINF
	tristate "MediaTek SENINF CSI-2 receiver"
	depends on V4L_PLATFORM_DRIVERS
	depends on VIDEO_DEV && OF
	depends on ARCH_MEDIATEK || COMPILE_TEST
	depends on PM
	select GENERIC_PHY
	select MEDIA_CONTROLLER
	select V4L2_FWNODE
	select VIDEO_V4L2_SUBDEV_API
	help
	  Support for the SENINF MIPI CSI-2 receiver of the MediaTek MT8183
	  family (also MT6771). It decodes the D-PHY streams of the camera
	  sensors; capturing the frames needs a further driver.

	  To compile this driver as a module, choose M here: the module will
	  be called mtk-seninf.
```

## drivers/net/wireless/mediatek/mt6771-consys/Kconfig
```kconfig
# SPDX-License-Identifier: GPL-2.0-only
config MT6771_CONSYS
	tristate "MediaTek MT6771 CONSYS wifi (vendor gen3 stack, compile-only port)"
	depends on ARCH_MEDIATEK || COMPILE_TEST
	depends on CFG80211
	depends on GPIOLIB
	depends on IPV6
	depends on MMC
	depends on RTC_CLASS
	select NL80211_TESTMODE
	select ZLIB_DEFLATE
	select WIRELESS_EXT
	select WEXT_PRIV
	default n
	help
	  The vendor 4.4 wifi stack for the CONSYS combo radio in the MT6771
	  (WMT/STP core, consys power-up, firmware download and the "gen3"
	  MT6631 wlan driver), carried into mainline unmodified in logic.

	  This is stage 1 of the port: it is meant to COMPILE against this
	  kernel, and nothing more. The platform services the vendor tree got
	  from its mt-plat headers (EMI MPU, clkbuf, PMIC rails, SPM, BTIF)
	  are stubs in mtk_plat_shim.h that log and return -ENOSYS, so the
	  driver cannot power the radio yet.

	  Say N. If unsure, say N.

config MT6771_CONSYS_BT
	tristate "MediaTek MT6771 CONSYS Bluetooth"
	depends on MT6771_CONSYS && BT
	help
	  Bluetooth function of the CONSYS combo radio as a kernel HCI
	  device, on the STP transport of the wifi stack.

config MT6771_CONSYS_GPS
	tristate "MediaTek MT6771 CONSYS GPS"
	depends on MT6771_CONSYS
	help
	  GPS function of the CONSYS combo radio: the vendor /dev/stpgps
	  and /dev/gps_emi character devices, unchanged in interface, for
	  the vendor mnld daemon.

config MT6771_CONSYS_FM
	tristate "MediaTek MT6771 CONSYS FM radio"
	depends on MT6771_CONSYS
	help
	  FM receiver function of the CONSYS combo radio (an MT6631 FM
	  core): the vendor /dev/fm character device, unchanged in
	  interface, for the vendor FM HAL.

config MTK_CONN_LTE_IDC_SUPPORT
	bool "LTE coexistence (IDC) messages with the modem"
	depends on MT6771_CONSYS && MTK_CONN_MD
	depends on MTK_CONN_MD = y || MT6771_CONSYS = m
	default y
	help
	  The WMT core exchanges in-device coexistence messages with the
	  modem's LTE layer through the connsys/modem bridge, and tells
	  the CONNSYS firmware at power-on that it shares the device with
	  LTE, as the vendor kernel does on this phone.

# The vendor Makefiles and sources test these by their vendor names. They
# are fixed for the one chip this directory supports and are not meant to
# be set by hand.
config MTK_COMBO_CHIP
	string
	depends on MT6771_CONSYS
	default "CONSYS_6771"

config MTK_PLATFORM
	string
	depends on MT6771_CONSYS
	default "mt6771"

config MTK_COMBO
	bool
	depends on MT6771_CONSYS
	default y

config MTK_COMBO_WIFI
	bool
	depends on MT6771_CONSYS
	default y

config MTK_COMBO_GPS
	bool
	depends on MT6771_CONSYS_GPS
	default y

config MTK_GPS_EMI
	bool
	depends on MT6771_CONSYS_GPS
	default y

config MTK_FMRADIO
	bool
	depends on MT6771_CONSYS_FM
	default y

config MACH_MT6771
	bool
	depends on MT6771_CONSYS
	default y

config MTK_BTIF
	bool
	depends on MT6771_CONSYS
	default y

config MTK_EMI
	bool
	depends on MT6771_CONSYS
	default y
```
